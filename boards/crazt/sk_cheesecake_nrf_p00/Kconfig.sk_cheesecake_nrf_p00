## boards/crazt/sk_cheesecake_nrf_p00/Kconfig.sk_cheesecake_nrf_p00
```kconfig
# Copyright (c) 2026
# SPDX-License-Identifier: Apache-2.0

config BOARD_SK_CHEESECAKE_NRF_P00
	select SOC_NRF52840_QIAA
	select BOARD_EARLY_INIT_HOOK

config BOARD_SK_CHEESECAKE_NRF_P00_DEV
	bool
	default y if BOARD_SK_CHEESECAKE_NRF_P00_NRF52840_DEV

config BOARD_SK_CHEESECAKE_NRF_P00_UF2
	bool
	default y if BOARD_SK_CHEESECAKE_NRF_P00_NRF52840_UF2
```

## boards/crazt/sk_cheesecake_nrf_p00/sk_cheesecake_nrf_p00_dev_defconfig
```kconfig
# Copyright (c) 2026
# SPDX-License-Identifier: Apache-2.0

CONFIG_ARM_MPU=y
CONFIG_HW_STACK_PROTECTION=y

CONFIG_SLIMEVR_USB_DEVICE_MANUFACTURER="SlimeVR"
CONFIG_SLIMEVR_USB_DEVICE_PRODUCT="SlimeNRF Tracker SK CheeseCake NRF P00 Dev"

CONFIG_BATTERY_USE_REG_LDO_MAPPING=y
CONFIG_LED_RGB_COLOR=y
CONFIG_LED_STRIP=y
CONFIG_LED_GLOBAL_BRIGHTNESS_PPTT=1000
CONFIG_LED_DEFAULT_COLOR_R=8235
CONFIG_LED_DEFAULT_COLOR_G=6353
CONFIG_LED_DEFAULT_COLOR_B=6667
CONFIG_SPI=y

# Experimental TCAL Heat settings
CONFIG_SYSTEM_IMU_HEATER_MAX_DUTY_PPTT=9900
CONFIG_SENSOR_TCAL_HEATED_DEFAULT_KP=300
CONFIG_SENSOR_TCAL_HEATED_DEFAULT_KI=5
CONFIG_SENSOR_TCAL_HEATED_DEFAULT_KFF=420

# Development image: no UF2 bootloader, no SoftDevice, app starts at flash base.
# CONFIG_BUILD_OUTPUT_UF2 is not set
CONFIG_FLASH_LOAD_OFFSET=0x0
```

## boards/crazt/sk_cheesecake_nrf_p00/sk_cheesecake_nrf_p00_uf2_defconfig
```kconfig
# Copyright (c) 2026
# SPDX-License-Identifier: Apache-2.0

CONFIG_ARM_MPU=y
CONFIG_HW_STACK_PROTECTION=y

CONFIG_SLIMEVR_USB_DEVICE_MANUFACTURER="SlimeVR"
CONFIG_SLIMEVR_USB_DEVICE_PRODUCT="SlimeNRF Tracker SK CheeseCake NRF P00"

CONFIG_BATTERY_USE_REG_LDO_MAPPING=y
CONFIG_LED_RGB_COLOR=y
CONFIG_LED_STRIP=y
CONFIG_LED_GLOBAL_BRIGHTNESS_PPTT=1000
CONFIG_SPI=y

# Experimental TCAL Heat settings
CONFIG_SYSTEM_IMU_HEATER_MAX_DUTY_PPTT=9900
CONFIG_SENSOR_TCAL_HEATED_DEFAULT_KP=300
CONFIG_SENSOR_TCAL_HEATED_DEFAULT_KI=5
CONFIG_SENSOR_TCAL_HEATED_DEFAULT_KFF=420

# Generate for Adafruit UF2 bootloader flashing.
CONFIG_BUILD_OUTPUT_UF2=y
CONFIG_BUILD_OUTPUT_UF2_FAMILY_ID="0xADA52840"
CONFIG_FLASH_LOAD_OFFSET=0x1000
```

## boards/crazt/sk_cheesecake_nrf_p10/board.yml
```yaml
# Copyright (c) 2026
# SPDX-License-Identifier: Apache-2.0

board:
  name: sk_cheesecake_nrf_p10
  full_name: SK CheeseCake NRF P10
  vendor: crazt
  socs:
    - name: nrf52840
      variants:
      - name: 'dev'
      - name: 'uf2'
```

## drivers/led_strip/Kconfig
```kconfig
# Copyright (c) 2026
# SPDX-License-Identifier: Apache-2.0

config CRAZT_WS2812_STRIP_I2S
	bool "Crazt WS2812 LED strip I2S driver"
	default y
	depends on DT_HAS_CRAZT_WS2812_I2S_ENABLED
	select I2S if $(dt_compat_on_bus,$(DT_COMPAT_CRAZT_WS2812_I2S),i2s)
	help
	  Enable the project-local WS2812 (and compatible) LED strip driver
	  using I2S. This driver mirrors the SDK WS2812 I2S driver so it can
	  be maintained independently of the Zephyr SDK.
```

## tests/customer_info/testcase.yaml
```yaml
tests:
  customer_info.parser:
    tags:
      - customer_info
    platform_allow:
      - native_sim/native/64
    harness: ztest
```

## tests/remote_heated_tcal/testcase.yaml
```yaml
tests:
  tracker.remote_heated_tcal.contract:
    platform_allow:
      - native_sim/native/64
    integration_platforms:
      - native_sim/native/64
    tags:
      - protocol
      - remote_heated_tcal
```
